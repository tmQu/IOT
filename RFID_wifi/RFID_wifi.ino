
#include <SPI.h>
#include <MFRC522.h>
#include <ESP8266WiFi.h>
#include <PubSubClient.h>
#include <Wire.h>
#include <Adafruit_GFX.h>
#include <Adafruit_SSD1306.h>
#include <WiFiManager.h>
 
#define SCREEN_WIDTH 128 // OLED width, pixel size
#define SCREEN_HEIGHT 64 // OLED height, pixel size
#define GREEN 
#define OLED_RESET    -1 // Resetpin # (or -1 if you are connecting the aduino to the resetpin)

#define PIR_MODE 0
#define RFID_MODE 1

#define PIR_IN 2 
#define PIR_OUT 0
Adafruit_SSD1306 display(SCREEN_WIDTH, SCREEN_HEIGHT, &Wire, OLED_RESET);

//wifi
const char ssid[] = "Penguin";
const char password[] = "1234567890";


long waitCallBack = -1;



#define RST_PIN 16  // Configurable, see typical pin layout above
#define SS_PIN 15  // Configurable, see typical pin layout above

#define MASTER_CARD 1
#define EMPLOYEE_CARD 0

MFRC522 mfrc522(SS_PIN, RST_PIN);  // Create MFRC522 instance.

byte defaultKey[6] = { 0xFF, 0xFF, 0xFF, 0xFF, 0xFF, 0xFF };

char passwordOpenDoor[34] = "211274072112738221127335";

int MODE = RFID_MODE;
// 'account-cancel-outline', 128x64px
const unsigned char denied [] PROGMEM = {
	0x00, 0x00, 0x00, 0x00, 0x00, 0x00, 0x00, 0x00, 0x00, 0x00, 0x00, 0x00, 0x00, 0x00, 0x00, 0x00, 
	0x00, 0x00, 0x00, 0x00, 0x00, 0x00, 0x00, 0x00, 0x00, 0x00, 0x00, 0x00, 0x00, 0x00, 0x00, 0x00, 
	0x00, 0x00, 0x00, 0x00, 0x00, 0x00, 0x00, 0x00, 0x00, 0x00, 0x00, 0x00, 0x00, 0x00, 0x00, 0x00, 
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	0x00, 0x00, 0x00, 0x00, 0x00, 0x00, 0x00, 0x00, 0x00, 0x00, 0x00, 0x00, 0x00, 0x00, 0x00, 0x00
};


// 'account-check-outline', 128x64px
const unsigned char accept [] PROGMEM = {
	0x00, 0x00, 0x00, 0x00, 0x00, 0x00, 0x00, 0x00, 0x00, 0x00, 0x00, 0x00, 0x00, 0x00, 0x00, 0x00, 
	0x00, 0x00, 0x00, 0x00, 0x00, 0x00, 0x00, 0x00, 0x00, 0x00, 0x00, 0x00, 0x00, 0x00, 0x00, 0x00, 
	0x00, 0x00, 0x00, 0x00, 0x00, 0x00, 0x00, 0x00, 0x00, 0x00, 0x00, 0x00, 0x00, 0x00, 0x00, 0x00, 
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	0x00, 0x00, 0x00, 0x00, 0x00, 0x00, 0x00, 0x00, 0x00, 0x00, 0x00, 0x00, 0x00, 0x00, 0x00, 0x00
};

 

int timeForCounting = 2000;
long timeForRegister = 120000;

struct PersonInformation {
  char id[9];
  char name[34];
  char role;
  PersonInformation(char *inputId, char *inputName, char inputRole)
  {
    strcpy(id, inputId);
    strcpy(name, inputName);
    role = inputRole;
  }
};

void printMonitor(char *buffer, int wait = 10000)
{
  display.clearDisplay();
  display.setTextSize(1.6);
  display.setTextColor(WHITE);
  display.setCursor(0, 0);
  // Display static text
  display.println(buffer);
  display.display();
  delay(wait);  
  display.clearDisplay();
  display.display();
}


void writeToBlock(byte buffer[], byte block)
{
  MFRC522::MIFARE_Key key;
  for (byte i = 0; i < 6; i++)
    key.keyByte[i] = defaultKey[i];

  MFRC522::StatusCode status = mfrc522.PCD_Authenticate(MFRC522::PICC_CMD_MF_AUTH_KEY_A, block, &key, &(mfrc522.uid));
  if (status != MFRC522::STATUS_OK) {
    Serial.print(F("PCD_Authenticate() failed: "));
    Serial.println(mfrc522.GetStatusCodeName(status));
    return;
  }
  else Serial.println(F("PCD_Authenticate() success: "));

  // Write block
  status = mfrc522.MIFARE_Write(block, buffer, 16);
  if (status != MFRC522::STATUS_OK) {
    Serial.print(F("MIFARE_Write() failed: "));
    Serial.println(mfrc522.GetStatusCodeName(status));
    return;
  }
  else Serial.println(F("MIFARE_Write() success: "));
}

bool writeInformation(PersonInformation person) {


  if (!mfrc522.PICC_IsNewCardPresent()) {
    return false;
  }

  // Select one of the cards
  if (!mfrc522.PICC_ReadCardSerial()) {
    return false;
  }

  Serial.print(F("Writing card UID:"));  //Dump UID
  for (byte i = 0; i < mfrc522.uid.size; i++) {
    Serial.print(mfrc522.uid.uidByte[i] < 0x10 ? " 0" : " ");
    Serial.print(mfrc522.uid.uidByte[i], HEX);
  }

  byte buffer[48];
  byte block;

  //---------------------------------------------------------
  //writing to sector 1 password
  for (int i = 0; i < strlen(passwordOpenDoor); i++)
    buffer[i] = (byte)passwordOpenDoor[i];

  buffer[strlen(passwordOpenDoor)] = (byte)person.role;
  
  writeToBlock(buffer, 1);
  writeToBlock(buffer + 16, 2);



  //writing id to card
  for (int i = 0; i < strlen(person.id); i++)
    buffer[i] = (byte)person.id[i];
  buffer[strlen(person.id)] = 0;

  writeToBlock(buffer, 6);
  mfrc522.PICC_HaltA(); // Halt PICC
  mfrc522.PCD_StopCrypto1();  // Stop encryption on PCD
  return true;
}


//return -1 not valid card
// return 1 master card
// return 0 employee card
int checkPasswordOpenDoor(byte id[])
{
  byte buffer[34];
  byte len = 18;

  MFRC522::StatusCode status;
  MFRC522::MIFARE_Key key;
  for (byte i = 0; i < 6; i++) key.keyByte[i] = 0xFF;

  byte block;
  block = 1;
  status = mfrc522.PCD_Authenticate(MFRC522::PICC_CMD_MF_AUTH_KEY_A, block, &key, &(mfrc522.uid)); //line 834 of MFRC522.cpp file
  if (status != MFRC522::STATUS_OK) {
    Serial.print(F("Authentication failed: "));
    Serial.println(mfrc522.GetStatusCodeName(status));
    return -1;
  }

  status = mfrc522.MIFARE_Read(block, buffer, &len);
  if (status != MFRC522::STATUS_OK) {
    Serial.print(F("Reading failed: "));
    Serial.println(mfrc522.GetStatusCodeName(status));
    mfrc522.PICC_HaltA();
    mfrc522.PCD_StopCrypto1();
    return -1;
  }

  block = 2;
  status = mfrc522.PCD_Authenticate(MFRC522::PICC_CMD_MF_AUTH_KEY_A, block, &key, &(mfrc522.uid)); //line 834 of MFRC522.cpp file
  if (status != MFRC522::STATUS_OK) {
    Serial.print(F("Authentication failed: "));
    Serial.println(mfrc522.GetStatusCodeName(status));
    
    return -1;
  }

  status = mfrc522.MIFARE_Read(block, buffer + 16, &len);
  if (status != MFRC522::STATUS_OK) {
    Serial.print(F("Reading failed: "));
    Serial.println(mfrc522.GetStatusCodeName(status));
    mfrc522.PICC_HaltA();
    mfrc522.PCD_StopCrypto1();
    return -1;
  }
  // read id
  block = 6;
  status = mfrc522.PCD_Authenticate(MFRC522::PICC_CMD_MF_AUTH_KEY_A, block, &key, &(mfrc522.uid)); //line 834 of MFRC522.cpp file
  if (status != MFRC522::STATUS_OK) {
    Serial.print(F("Authentication failed: "));
    Serial.println(mfrc522.GetStatusCodeName(status));
    
    return -1;
  }


  status = mfrc522.MIFARE_Read(block, id, &len);
  if (status != MFRC522::STATUS_OK) {
    Serial.print(F("Reading failed: "));
    Serial.println(mfrc522.GetStatusCodeName(status));
    mfrc522.PICC_HaltA();
    mfrc522.PCD_StopCrypto1();
    return -1;
  }
  id[8] = 0;
  id[9] = 0;
  Serial.println(F("\n**End Reading**\n"));  
  mfrc522.PICC_HaltA();
  mfrc522.PCD_StopCrypto1();
  int i = 0;
  for (i = 0; i < strlen(passwordOpenDoor); i++)
  {
    if (buffer[i] != (byte) passwordOpenDoor[i])
      return -1;
  }
  Serial.println((char)buffer[i]);
  if (buffer[i] == (byte)'M')
    return MASTER_CARD;
    

  return EMPLOYEE_CARD;
}

//***Set server***
const char* mqttServer = "broker.hivemq.com"; 
int port = 1883;

WiFiClient wifiClient;
PubSubClient mqttClient(wifiClient);


//MQTT Receiver

void callback(char* topic, byte* message, unsigned int length) {
  Serial.println(topic);
  if (strcmp(topic, "IOT_Smart_Door/RFID/Get_New_Card_Info") == 0)
  {
    //Parse msg
    display.clearDisplay();
    display.setTextSize(1);
    display.setTextColor(WHITE);
    display.setCursor(0, 10);
    // Display static text
    display.println("PLACE NEW CARD");
    display.display();
    char *msg = (char*)message;
    char *id = strtok (msg + 2, "\",\"");
    char *name = strtok(NULL, "\",\"");
    char role = strtok(NULL, "\",\"")[0];

    PersonInformation person(id, name, role);
    long startWait = millis();
    bool statusWrite = false;
    while(millis() - startWait <= 5000)
    {
      statusWrite = writeInformation(person);
      if(statusWrite == true)
        break;
    }

    if(statusWrite == true)
    {
      Serial.print("Write successfully");
      printMonitor("Write successfully", 5000);
    }
    else {
      Serial.print("Write unsuccessfully, please delete the data and try again");
      printMonitor("Write unsuccessfully, please delete the data and try again",5000);

    }
    waitCallBack = millis();
  }
  else if(strcmp(topic, "IOT_Smart_Door/RFID/AccessPermission")== 0)
  {
      String strMsg = "";
      for(int i=0; i<length; i++) {
        strMsg += (char)message[i];
      }
  Serial.println(strMsg);  
    if (strMsg == "accept")
    {
            Serial.println("per");
      Serial.println("accept");
      display.clearDisplay();

      // Bitmap Image Output
      display.drawBitmap(0, 0, accept, 128, 64, WHITE);
      display.display();

      delay(8000);
      display.clearDisplay();
      display.display();

    }
    else if (strMsg = "denied")
    {

      display.clearDisplay();

      // Bitmap Image Output
      display.drawBitmap(0, 0, denied, 128, 64, WHITE);
      display.display();

      delay(8000);
      display.clearDisplay();
      display.display();
    }
  }
  else if (strcmp(topic, "IOT_Smart_Door/Door_Mode") == 0)
  {
      String strMsg = "";
      for(int i=0; i<length; i++) {
        strMsg += (char)message[i];
      }
  Serial.println(strMsg);

    if (strMsg == "RFID")
    {
          Serial.println("test1");
      MODE = RFID_MODE;
    }
    else
    {
          Serial.println("test2");
      MODE = PIR_MODE;
    }
    Serial.println("test");
  }
  //***Code here to process the received package***

}

void wifiConnect() {
  WiFi.begin(ssid, password);

  while (WiFi.status() != WL_CONNECTED) {
    delay(500);
    Serial.print(".");
  }
  Serial.println(" Connected!");
}

void mqttConnect() {
  while(!mqttClient.connected()) {
    Serial.println("Attemping MQTT connection...");
    String clientId = "ESP8266Client-";
    clientId += String(random(0xffff), HEX);
    Serial.print(clientId);
    if(mqttClient.connect(clientId.c_str())) {
      Serial.println("connected");

      //subcribe
      mqttClient.subscribe("IOT_Smart_Door/RFID/Get_New_Card_Info");
      mqttClient.subscribe("IOT_Smart_Door/RFID/AccessPermission");
      mqttClient.subscribe("IOT_Smart_Door/Door_Mode");

     
    }
    else {
      Serial.println("try again in 5 seconds");
      delay(5000);
    }
  }
}


void setup(){
  pinMode(PIR_IN, INPUT_PULLUP);
  pinMode(PIR_OUT, INPUT_PULLUP);



  Serial.begin(9600);  // Initialize serial communications with the PC
  while (!Serial);  
    if(!display.begin(SSD1306_SWITCHCAPVCC, 0x3C)) {  
      Serial.println(F("SSD1306 Not Connected"));
      for(;;);    // If SSD1306 is not addressed, infinite loop
  }

  // // Clear Buffer
  display.clearDisplay();
  display.display();
                               // Do nothing if no serial port is opened (added for Arduinos based on ATMEGA32U4)
  SPI.begin();                        // Init SPI bus
  mfrc522.PCD_Init();                 // Init MFRC522 card
                                      // put your setup code here, to run once:
  mfrc522.PCD_DumpVersionToSerial();  // Show details of PCD - MFRC522 Card Reader details
  WiFiManager wm;
  Serial.print("Connecting to WiFi");
  bool res;
    // res = wm.autoConnect(); // auto generated AP name from chipid
    // res = wm.autoConnect("AutoConnectAP"); // anonymous ap
    res = wm.autoConnect("RFID_PIR","password"); // password protected ap

    if(!res) {
        Serial.println("Failed to connect");
        // ESP.restart();
    } 
    else {
        //if you get here you have connected to the WiFi    
        Serial.println("connected...yeey :)");
    }
  mqttClient.setServer(mqttServer, port);
  mqttClient.setCallback(callback);
  mqttClient.setKeepAlive( 90 );
  mqttConnect();

  //mqttClient.publish("", )
}


void loop() {
  if(!mqttClient.connected()) {
    mqttConnect();
  }
  mqttClient.loop();


  if (MODE == RFID_MODE)
  {
    if (!mfrc522.PICC_IsNewCardPresent()) {
      return;
    }
    // Select one of the cards
    if (!mfrc522.PICC_ReadCardSerial()) {
      return;
    }

    // get uid
    byte uid[10];
    byte id[18];
    for (byte i = 0; i < 10; i++)
    {
      uid[i] = mfrc522.uid.uidByte[i];
    }
    int card = checkPasswordOpenDoor(id);
    Serial.println((char*)(id));

    if (waitCallBack != -1)
    {
      if(millis() - waitCallBack <= timeForRegister)
      {
        
      }
      else
      {
        Serial.println("Timeout register");
        mqttClient.publish("IOT_Smart_Door/Register_NewCard", "timeout");
        waitCallBack = -1;
      }
      Serial.println("No exit");
      Serial.println(card);
      if (card == MASTER_CARD)
      {
        mqttClient.publish("IOT_Smart_Door/RFID/Register_NewCard", "disablebutton");
        Serial.println("Exit register mode");
        printMonitor("Exit register mode", 5000);
        waitCallBack = -1;
        return;
      }
    }

    // Invalid card
    Serial.print("card");
    Serial.println(card);
    if (card == -1)
    {
      printMonitor("INVALID CARD", 3000);
      return;
    }
      

    //mfrc522.PICC_HaltA();  // Stop reading
    int count = 1;
    unsigned long startCounting = millis();
    while (millis() - startCounting <= timeForCounting) {

      if (!mfrc522.PICC_IsNewCardPresent()) {
        continue;
      }
      // Select one of the cards
      if (!mfrc522.PICC_ReadCardSerial()) {
        continue;
      }
      

      for (int i = 0; i < 10; i++)
        if (uid[i] != mfrc522.uid.uidByte[i]) {
          count = 0;
          Serial.print(uid[i]);
          Serial.print(" ");
          Serial.print(mfrc522.uid.uidByte[i]);
          Serial.println("return");
          return;
        }
      count++;
      Serial.print("count in for ");
      Serial.println(count);
      mfrc522.PICC_HaltA();  // Stop reading
      startCounting = millis();
    }


    Serial.println(count);
    if (card == EMPLOYEE_CARD)
    {
      if (count == 1)
      {
        Serial.println("open");
        mqttClient.publish("IOT_Smart_Door/RFID/OpenDoor", (char *)id);
        return;
      }
      else if (count >= 3)
      {
        mqttClient.publish("IOT_Smart_Door/Req_Enter", (char *)id);
      }
    }
    else if (card == MASTER_CARD)
    {
      if (count == 1) // register a new card
      {
        Serial.println("Register new card\n");
        display.clearDisplay();
        display.setTextSize(1.6);
        display.setTextColor(WHITE);
        display.setCursor(0, 10);
        display.display();
        display.println("Register Mode\nPlease input data on web");
        display.display();
        waitCallBack = millis();
        mqttClient.publish("IOT_Smart_Door/RFID/Register_NewCard", "register");
      }
      else if (count >= 2)
      {

        Serial.println("open");
        mqttClient.publish("IOT_Smart_Door/RFID/OpenDoor", (char *)id);
        waitCallBack = millis();
      }
    }
  }
  else if(MODE == PIR_MODE)
  {
    int sensorIn = digitalRead(PIR_IN);
    int sensorOut = digitalRead(PIR_OUT);
    if (sensorIn == 1 || sensorOut == 1)
    {
    mqttClient.publish("IOT_Smart_Door/Motor/OpenAuto", "Accept");
    delay(15000);
    }

  }

  


}
